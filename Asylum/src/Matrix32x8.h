// Matrix32x8.h

//#if (defined DEVICE_TYPE_MATRIX32X8)

#ifndef _DISPLAY32X8_h
#define _DISPLAY32X8_h

#include <Wire.h>
#include <BME280I2C.h>
#include <RTClib.h>
#include <NeoPixelBrightnessBus.h>
#include <ESPAsyncTCP.h>
#include <ESPAsyncUDP.h>
#include <TimeLib.h>
#include <Ticker.h>
#include <NtpClientLib.h>

#include <ESP8266WiFi.h>
#include <AsyncMqttClient.h>
#include "../Device.h"

#define debug(format, ...) Serial.printf_P((PGM_P)F(format), ## __VA_ARGS__)

#define LEDS_COUNT 256
#define DISPLAY_HEIGHT 8
#define DISPLAY_WIDTH 32
#define BRIGHTNESS_AVERAGE 10
#define PIN_ADC A0

#define INTERVAL_BUTTON_DEBOUNCE	    100
#define INTERVAL_BUTTON_IDLE	        200
#define INTERVAL_LED_SETUP	          500
#define INTERVAL_LED_SMARTCONFIG      250
#define INTERVAL_STATE_PUBLISH		    200
#define INTERVAL_UPDATE_FRAME    		  60
#define INTERVAL_TETRIS_STARTSPEED    500
#define INTERVAL_SNAKE_STARTSPEED     300
#define INTERVAL_SNAKE_STARTLENGHT    5

#define PRIMARY_LAST_SLIDE 5
#define MENU_LAST_SLIDE 3

#define FORECAST_APIKEY "SsoLJaPCnLxZcYqlYrnu5OpglA8S5BzS"
#define FORECAST_CITY   "294021"
#define INTERVAL_UPDATE_FORECAST     	10000

#define NTP_TIMEOUT 1500
#define NTP_SERVER "pool.ntp.org"
#define INTERVAL_UPDATE_NTP     		  5000

enum states { INTRO = -1, MENU = 0, PRIMARY = 1, TETRIS = 2, SNAKE = 3 };
enum direction { LEFT = 0, TOP = 1, RIGHT = 2, BOTTOM = 3 };

struct point {
  int8_t x;
  int8_t y;
};


class Matrix32x8 : public Device
{
public:
  Matrix32x8(String prefix, byte event, byte event2, byte event3, byte event4);

  void initialize(AsyncMqttClient* ptr_mqttClient, Config* ptr_config);

  void update();

  void publishState();

  void updateState(ulong state_new);
  void updatePrimarySlide(int8_t slide_new);
  void updateMenuSlide(int8_t slide_new);
  void print_updating();

  // NOTE: These will ignore the PIN and use GPI03 pin
  NeoPixelBrightnessBus<NeoGrbFeature, NeoEsp8266Dma800KbpsMethod> leds;
  NeoTopology<RowMajor90Layout> topo;


  BME280I2C bme;
  RTC_DS1307 rtc;
  AsyncClient* httpClient;

  void AsyncClient_onConnect(void* arg, AsyncClient* client);
  void AsyncClient_onData(void* arg, AsyncClient* client, void* data, size_t len);

protected:
  // current state (-1 intro, 0 menu, 1 time, 2 tetris, 3 snake)
  ulong state = INTRO;
  ulong state_old = INTRO;

  // current primary_slide (0 time, 1 date, 2 temp, 3 hum, 4 pres, 5 forecast)
  int8_t primary_slide = 0;

  // current menu_slide (1 primary, 2 tetris, 3 snake)
  int8_t menu_slide = PRIMARY;

  byte  pin_up;
  byte  pin_down;
  byte  pin_left;
  byte  pin_right;

  Button btn_up;
  Button btn_down;
  Button btn_left;
  Button btn_right;

  uint16_t desiredbrightness;
  byte  currentbrightness;
  unsigned long brightness_time = 0;

  DateTime datetime;
  int ntp_updateday = -1;

  float temp, hum, pres;

  double forecast_tempmin, forecast_tempmax;
  int forecast_dayicon, forecast_nighticon;
  unsigned long forecast_time = 0;


  bool ntp_started = false;
  int8_t ntp_timezone = 3;
  int8_t ntp_timezoneminutes = 0;
  time_t ntp_lastsync = 0;
  unsigned long ntp_time = 0;

  uint16_t timeline = 0;
  unsigned long timeline_time = 0;

  bool fadein = false;
  bool fadeout = false;

  void draw_picture(uint16_t index, byte xoffset);
  void clearframe();
  RgbColor Wheel(byte WheelPos);
  void show_frame();
  void prepareframe_intro();
  void prepareframe_primary_time();
  void prepareframe_primary_date();
  void prepareframe_primary_climatetemp();
  void prepareframe_primary_climatehum();
  void prepareframe_primary_climatepres();
  void prepareframe_primary_forecast();
  void prepareframe_tetris();
  void prepareframe_snake();

  bool getntp(RTC_DS1307* dt);
  bool getforecast(double* forecast_tempmin, double* forecast_tempmax, int* forecast_dayicon, int* forecast_nighticon);

  void tetris_reset();
  bool tetris_check_collision(uint16_t f, uint16_t a, int8_t v, int8_t h);
  void tetris_show_figure(uint16_t f, uint16_t a, int8_t v, int8_t h);
  void tetris_erase_figure(uint16_t f, uint16_t a, int8_t v, int8_t h);
  void tetris_erase_lines();
  bool tetris_move_figure_vertical(int8_t new_horizontal);
  void tetris_move_figure_horizontal(int8_t new_horizontal);
  void tetris_rotate_figure(uint16_t new_horizontal);

  void snake_reset();
  void snake_show_map();
  void snake_give_food();
  void snake_give_extrafood();
  bool snake_move();

  // tetris vars
  uint16_t tetris_step_interval = INTERVAL_TETRIS_STARTSPEED;
  ulong    tetris_step_time = millis();
  uint16_t tetris_nextfigure = 0, tetris_figure = 0, tetris_nextangle = 0, tetris_angle = 0;
  int8_t   tetris_vertical = 0, tetris_horizontal = 1;

  // snake vars
  uint16_t snake_step_interval = INTERVAL_SNAKE_STARTSPEED;
  ulong    snake_step_time = millis();
  int16_t  snake_map[DISPLAY_WIDTH][DISPLAY_HEIGHT];
  point snake_head;
  byte  snake_lenght = INTERVAL_SNAKE_STARTLENGHT;
  byte  snake_crazy;
  direction snake_direction;
  direction snake_nextdirection;

  bool print_string(String data, uint16_t xoffset, RgbColor color);
  bool print_smallstring(String data, uint16_t xoffset, RgbColor color);
  String utf8rus(String source);

};

#pragma region AsyncClient

static Matrix32x8* matrixinstance;
ICACHE_RAM_ATTR static void AsyncClient_onConnectHandler(void* arg, AsyncClient* client) {
  matrixinstance->AsyncClient_onConnect(arg, client);
}

ICACHE_RAM_ATTR static void AsyncClient_onDataHandler(void* arg, AsyncClient* client, void* data, size_t len) {
  matrixinstance->AsyncClient_onData(arg, client, data, len);
}

#pragma endregion



typedef struct ConvLetter {
  char    win1251;
  int     unicode;
} Letter;

static Letter g_letters[] = {
        {0x82, 0x201A}, // SINGLE LOW-9 QUOTATION MARK
        {0x83, 0x0453}, // CYRILLIC SMALL LETTER GJE
        {0x84, 0x201E}, // DOUBLE LOW-9 QUOTATION MARK
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        {0xBF, 0x0457}  // CYRILLIC SMALL LETTER YI
};

static bool utf8_to_cp1251(const char* utf8, char* windows1251, size_t n)
{
  int j = 0;
  for (int i = 0; i < (int)n && utf8[i] != 0; ++i) {
    char prefix = utf8[i];
    char suffix = utf8[i + 1];
    if ((prefix & 0x80) == 0) {
      windows1251[j] = (char)prefix;
      ++j;
    }
    else if ((~prefix) & 0x20) {
      int first5bit = prefix & 0x1F;
      first5bit <<= 6;
      int sec6bit = suffix & 0x3F;
      int unicode_char = first5bit + sec6bit;


      if (unicode_char >= 0x410 && unicode_char <= 0x44F) {
        windows1251[j] = (char)(unicode_char - 0x350);
      }
      else if (unicode_char >= 0x80 && unicode_char <= 0xFF) {
        windows1251[j] = (char)(unicode_char);
      }
      else if (unicode_char >= 0x402 && unicode_char <= 0x403) {
        windows1251[j] = (char)(unicode_char - 0x382);
      }
      else {
        int count = sizeof(g_letters) / sizeof(Letter);
        for (int k = 0; k < count; ++k) {
          if (unicode_char == g_letters[k].unicode) {
            windows1251[j] = g_letters[k].win1251;
            goto NEXT_LETTER;
          }
        }
        // can't convert this char
        return false;
      }
    NEXT_LETTER:
      ++i;
      ++j;
    }
    else {
      // can't convert this chars
      return false;
    }
  }
  windows1251[j] = 0;
  return true;
}

const byte Glyph[2048] PROGMEM = {
  0x7E,0x42,0x42,0x42,0x42,0x7E,0x0,0x0,
  0x7E,0x42,0x42,0x42,0x42,0x7E,0x0,0x0,
  0x7E,0x42,0x42,0x42,0x42,0x7E,0x0,0x0,
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  0x48,0x34,0x14,0x7C,0x0,0x0,0x0,0x0,     // ÿ
};

const byte SmallGlyph[2048] PROGMEM = {
  0x7E,0x42,0x42,0x42,0x42,0x7E,0x0,0x0,
  0x7E,0x42,0x42,0x42,0x42,0x7E,0x0,0x0,
  0x7E,0x42,0x42,0x42,0x42,0x7E,0x0,0x0,
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  0x48,0x34,0x14,0x7C,0x0,0x0,0x0,0x0,     // ÿ
};

const uint32_t Color[256] PROGMEM = {
  0x000000,  0x800000, 0x008000, 0x808000, 0x000080, 0x800080, 0x008080, 0xC0C0C0, 0x808080, 0xFF0000, 0x00FF00, 0xFFFF00, 0x0000FF, 0xFF00FF, 0x00FFFF, 0xFFFFFF,
  0x000000, 0x00005F, 0x000087, 0x0000AF, 0x0000D7, 0x0000FF, 0x005F00, 0x005F5F, 0x005F87, 0x005FAF, 0x005FD7, 0x005FFF, 0x008700, 0x00875F, 0x008787, 0x0087AF,
  0x0087D7, 0x0087FF, 0x00AF00, 0x00AF5F, 0x00AF87, 0x00AFAF, 0x00AFD7, 0x00AFFF, 0x00D700, 0x00D75F, 0x00D787, 0x00D7AF, 0x00D7D7, 0x00D7FF, 0x00FF00, 0x00FF5F,
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  0x585858, 0x626262, 0x6C6C6C, 0x767676, 0x808080, 0x8A8A8A, 0x949494, 0x9E9E9E, 0xA8A8A8, 0xB2B2B2, 0xBCBCBC, 0xC6C6C6, 0xD0D0D0, 0xDADADA, 0xE2E4E4, 0xEEEEEE
};

const byte WeatherPictures[2880] PROGMEM = {
  0x0,0x0,0x0,0x0,0x0,0x0,0x9,0x9,         // 0 Temperature
  0x0,0x0,0x0,0x0,0x0,0x9,0x9,0x9,
  0x0,0x0,0x0,0x0,0xF,0x9,0x9,0x0,
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  0x0,0xFC,0xFF,0xFC,0x0,0x0,0x0,0x0
};

const byte Figures[448] PROGMEM = {
  0x0,0x0,0x9,0x9,         // o 0
  0x0,0x0,0x9,0x9,
  0x0,0x0,0x0,0x0,
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  0x0,0x0,0x0,0x0
};

#endif
//#endif
